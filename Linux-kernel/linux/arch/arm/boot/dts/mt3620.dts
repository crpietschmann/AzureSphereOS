// SPDX-License-Identifier: GPL-2.0
/*
 * MTK3620 SoC
 *
 * Copyright (c)  2018 Microsoft Corporation. All rights reserved.
 *
 * This program is free software; you can redistribute it and/or modify it
 * under the terms and conditions of the GNU General Public License,
 * version 2, as published by the Free Software Foundation.
 *
 * This program is distributed in the hope it will be useful, but WITHOUT
 * ANY WARRANTY; without even the implied warranty of MERCHANTABILITY or
 * FITNESS FOR A PARTICULAR PURPOSE.  See the GNU General Public License for
 * more details.
 *
 * You should have received a copy of the GNU General Public License along with
 * this program; if not, write to the Free Software Foundation, Inc., 59 Temple
 * Place - Suite 330, Boston, MA 02111-1307 USA.
 *
 */

/dts-v1/;
#include "mt3620.dtsi"

/ {
	model = "MT3620";
	compatible = "mediatek,mt3620";

	aliases {
		serial1 = &uart1;
		serial4 = &isu0;
		serial5 = &isu1;
		serial6 = &isu2;
		serial7 = &isu3;
		serial8 = &isu4;
		serial9 = &isu5;
	};

	chosen {

	};
};
