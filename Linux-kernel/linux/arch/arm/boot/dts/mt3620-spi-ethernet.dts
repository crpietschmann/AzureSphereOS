/dts-v1/;
/plugin/;

#include <dt-bindings/interrupt-controller/irq.h>
#include <dt-bindings/interrupt-controller/arm-gic.h>
#include "mt3620-peripherals.dtsi"

/ {
	compatible = "mediatek,mt3620";
	preset = "lan-enc28j60-isu0-int5";

	fragment@0 {
		target = <&soc>;
		__overlay__ {
			spi0: spi@38070300 {
				compatible = "mediatek,mt3620-spi";
				reg = <0x38070300 0xff>;
				interrupts = <GIC_SPI 22 IRQ_TYPE_LEVEL_HIGH>;
				dmas = <&ca7dma 0>, <&ca7dma 1>;
				dma-names = "spi-dma-tx", "spi-dma-rx";
				clocks = <&spi_clk>;

				microsoft,pins = <
					PERIPHERAL_MAP_ENTRY(SPI_MASTER,0,SPI_MOSI,SPI_CS_B,26)
				>;

				microsoft,peripherals = <
					PERIPHERAL_ROUTING_ENTRY(SPI_MASTER,0,OWNER_NORMAL_WORLD_KERNEL)
				>;

				enc28j60: ethernet@0 {
					compatible = "microchip,enc28j60";
					reg = <0>;
					interrupts = <GIC_SPI 62 IRQ_TYPE_EDGE_RISING>;
					spi-max-frequency = <20000000>;
					microsoft,pins = <
						PERIPHERAL_MAP_ENTRY(EINT,0,5,5,5) // EINT[5] as GPIO5 
					>;
				};
			};
		};
	};
};
