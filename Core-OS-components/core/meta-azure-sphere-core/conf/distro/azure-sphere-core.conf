## Linux-kernel/linux/drivers/platform/azure_sphere/Kconfig
```kconfig
menuconfig AZURE_SPHERE
    bool "Azure Sphere platform support"
    depends on ARM

if AZURE_SPHERE

config NULL_CONSOLE
	bool "Null console device"
	help
	  Null console device that enables running without 
	  serial or VT subsystems

config AZURE_SPHERE_SECURITY_MONITOR
	bool "Azure Sphere Security Monitor support"
    depends on CPU_V7VE
	help
	  Security Monitor driver for Azure Sphere.

config AZURE_SPHERE_SECURITY_MONITOR_DEBUG
	bool "Azure Sphere Security Monitor debug output"
	depends on AZURE_SPHERE_SECURITY_MONITOR
	help
	  Security Monitor driver debug output.

config MT3620_PLUTON
	tristate "MT3620 Pluton transport"
	select MAILBOX
	select MT3620_MAILBOX
	depends on PLUTON_REMOTEAPI
	help
		MT3620 Pluton RemoteAPI support

config PLUTON_REMOTEAPI
	tristate "Pluton RemoteAPI support"
	help
	  Support for communicating with Pluton

config PLUTON_REMOTEAPI_DEBUG
	bool "Pluton RemoteAPI debug logging"
	depends on PLUTON_REMOTEAPI
	help
	  Debug logging for Pluton RemoteAPI driver

config AZURE_SPHERE_ASLR_PMD_ALIGN
	bool "Align ASLR to L2 page middle directory"
	help
		Modify ASLR to align to L2 page middle directory to save on memory footprint

config AZURE_SPHERE_IO_CORE_COMM
	tristate "Azure Sphere IO Core Communication
	depends on AZSPIO
	help
	  Support for communicating with IO Cores

config AZURE_SPHERE_RESET
	bool "AZSPHERE power-off and reset driver"
	help
	  Power off and reset support for AZSPHERE. 

endif # AZURE_SPHERE
```

## Linux-kernel/linux/fs/asxipfs/Kconfig
```kconfig
config ASXIPFS
	tristate "Azure Sphere XIP file system support (asxipfs)"
	depends on BLOCK
	help
	  Saying Y here includes support for ASXipFs (Azure Sphere's XIP ROM File
	  System).  

	  See <file:Documentation/filesystems/asxipfs.txt> and
	  <file:fs/asxipfs/README> for further information.

	  If unsure, say N.
```

## Linux-kernel/linux/fs/littlefs/Kconfig
```kconfig
config LITTLEFS
	tristate "Little File System (littlefs) support"
	depends on MTD
	select QUOTACTL
	help
	  LittleFS is a flash file system designed for minimal RAM overhead
```

## Linux-kernel/linux/net/azspio/Kconfig
```kconfig
# Azure Sphere IO Communication
#

config AZSPIO
	tristate "AZSPIO"
	depends on AZURE_SPHERE
	---help---
	  Azure Sphere IO Communication
```

## Linux-kernel/linux/security/azure_sphere/Kconfig
```kconfig
config SECURITY_AZURE_SPHERE
	bool "Azure Sphere LSM support"
	depends on SECURITY
	default n
	help
	  This enables the Azure Sphere LSM.

config AZURE_SPHERE_MMAP_EXEC_PROTECTION
	bool "Azure Sphere mmap protection"
	depends on SECURITY_AZURE_SPHERE
	default y
	help
		This enables memory protections to protect writable pages from being made executable
```
