## Core-OS-components/core/meta-azure-sphere-core/conf/distro/azure-sphere-core.conf
```bitbake
#
# This distro is based on the 'poky-tiny' distro; including the following
# configuration file imports its base configuration.
#

require conf/distro/poky-tiny.conf

#
# Suppress warnings around Ubuntu 16.04 and 18.04.
#

SANITY_TESTED_DISTROS += " Ubuntu-16.04 \n "
SANITY_TESTED_DISTROS += " ubuntu-18.04 \n "

#
# Define the 'azure-sphere-core' distro.
#

LOCALCONF_VERSION = "1"

DISTRO = "azure-sphere-core"
DISTRO_NAME = "Azure Sphere Core"

#
# The kernel is currently built outside of this Yocto layer
#

PREFERRED_PROVIDER_virtual/kernel = "linux-dummy"

#
# Remove features not needed
#

DISTRO_FEATURES_remove = "usbhost"

#
# Select the C runtime
#

TCLIBC = "musl"

#
# Turn on -Os (optimize for size)
#
FULL_OPTIMIZATION = "-Os -pipe ${DEBUG_FLAGS}"

#
# Glibc for native can't support -Os
#
FULL_OPTIMIZATION_pn-glibc-initial = "-O2 -pipe ${DEBUG_FLAGS}"
FULL_OPTIMIZATION_pn-glibc = "-O2 -pipe ${DEBUG_FLAGS}"
FULL_OPTIMIZATION_pn-nativesdk-glibc-initial = "-O2 -pipe ${DEBUG_FLAGS}"
FULL_OPTIMIZATION_pn-nativesdk-glibc = "-O2 -pipe ${DEBUG_FLAGS}"

#
# Add unwind to support stack walking in optimized code
#

FULL_OPTIMIZATION += "-funwind-tables"

#
# Do not use relocational read only sections
#

FULL_OPTIMIZATION += "-Wl,-z,norelro"

#
# Configure a minimal system
#

VIRTUAL-RUNTIME_base-utils = ""
VIRTUAL-RUNTIME_dev_manager = ""
VIRTUAL-RUNTIME_login_manager = ""
VIRTUAL-RUNTIME_init_manager = ""
VIRTUAL-RUNTIME_initscripts = ""
VIRTUAL-RUNTIME_keymaps = ""
```

## Core-OS-components/core/meta-azure-sphere-core/conf/layer.conf
```bitbake
# We have a conf and classes directory, add to BBPATH
BBPATH .= ":${LAYERDIR}"

# We have recipes-* directories, add to BBFILES
BBFILES += "${LAYERDIR}/recipes-*/*/*.bb \
	${LAYERDIR}/recipes-*/*/*.bbappend"

BBFILE_COLLECTIONS += "azure-sphere-core"
BBFILE_PATTERN_azure-sphere-core = "^${LAYERDIR}/"

#
# This is the base layer for Azure Sphere builds and runs at priority 6
#

BBFILE_PRIORITY_azure-sphere-core = "6"

LAYERSERIES_COMPAT_azure-sphere-core = "sumo thud"
```

## Core-OS-components/core/meta-azure-sphere-core/conf/machine/mt3620.conf
```bitbake
#@TYPE: Machine
#@NAME: mt3620
#@DESCRIPTION: Machine configuration for MediaTek MT3620
KMACHINE = "mt3620"

#
# Define 'mt3620' as having a Cortex-A7 core with hardware floating-point and
# NEON support.
#

DEFAULTTUNE ?= "cortexa7thf-neon"
ARM_INSTRUCTION_SET = "thumb"

include conf/machine/include/tune-cortexa7.inc

TARGET_CC_KERNEL_ARCH = "-march=armv7ve -mcpu=cortex-a7"
```

## Core-OS-components/core/meta-azure-sphere-core/recipes-connectivity/wpa-supplicant/files/defconfig
```kconfig
# Azure Sphere WPA supplicant config

# Driver interface for Host AP driver
#CONFIG_DRIVER_HOSTAP=y

# Driver interface for Linux drivers using the nl80211 kernel interface
CONFIG_DRIVER_NL80211=y

# driver_nl80211.c requires libnl. If you are compiling it yourself
# you may need to point hostapd to your version of libnl.
#
#CFLAGS += -I$<path to libnl include files>
#LIBS += -L$<path to libnl library files>

# Use libnl v2.0 (or 3.0) libraries.
#CONFIG_LIBNL20=y

# Use libnl 3.2 libraries (if this is selected, CONFIG_LIBNL20 is ignored)
CONFIG_LIBNL32=y

# Enable IEEE 802.1X Supplicant (automatically included if any EAP method is
# included)
#CONFIG_IEEE8021X_EAPOL=y

# EAP-MD5
#CONFIG_EAP_MD5=y

# EAP-MSCHAPv2
#CONFIG_EAP_MSCHAPV2=y

# EAP-TLS
CONFIG_EAP_TLS=y

# EAL-PEAP
#CONFIG_EAP_PEAP=y

# EAP-TTLS
#CONFIG_EAP_TTLS=y

# EAP-FAST
# Note: If OpenSSL is used as the TLS library, OpenSSL 1.0 or newer is needed
# for EAP-FAST support. Older OpenSSL releases would need to be patched, e.g.,
# with openssl-0.9.8x-tls-extensions.patch, to add the needed functions.
#CONFIG_EAP_FAST=y

# EAP-GTC
#CONFIG_EAP_GTC=y

# EAP-OTP
#CONFIG_EAP_OTP=y

# EAP-SIM (enable CONFIG_PCSC, if EAP-SIM is used)
#CONFIG_EAP_SIM=y

# EAP-PSK (experimental; this is _not_ needed for WPA-PSK)
#CONFIG_EAP_PSK=y

# EAP-pwd (secure authentication using only a password)
#CONFIG_EAP_PWD=y

# EAP-PAX
#CONFIG_EAP_PAX=y

# LEAP
#CONFIG_EAP_LEAP=y

# EAP-AKA (enable CONFIG_PCSC, if EAP-AKA is used)
#CONFIG_EAP_AKA=y

# EAP-AKA' (enable CONFIG_PCSC, if EAP-AKA' is used).
# This requires CONFIG_EAP_AKA to be enabled, too.
#CONFIG_EAP_AKA_PRIME=y

# Enable USIM simulator (Milenage) for EAP-AKA
#CONFIG_USIM_SIMULATOR=y

# EAP-SAKE
#CONFIG_EAP_SAKE=y

# EAP-GPSK
#CONFIG_EAP_GPSK=y
# Include support for optional SHA256 cipher suite in EAP-GPSK
#CONFIG_EAP_GPSK_SHA256=y

# EAP-TNC and related Trusted Network Connect support (experimental)
#CONFIG_EAP_TNC=y

# Wi-Fi Protected Setup (WPS)
#CONFIG_WPS=y
# Enable WSC 2.0 support
#CONFIG_WPS2=y
# Enable WPS external registrar functionality
#CONFIG_WPS_ER=y
# Disable credentials for an open network by default when acting as a WPS
# registrar.
#CONFIG_WPS_REG_DISABLE_OPEN=y
# Enable WPS support with NFC config method
#CONFIG_WPS_NFC=y

# EAP-IKEv2
#CONFIG_EAP_IKEV2=y

# EAP-EKE
#CONFIG_EAP_EKE=y

# PKCS#12 (PFX) support (used to read private key and certificate file from
# a file that usually has extension .p12 or .pfx)
#CONFIG_PKCS12=y

# Support HT overrides (disable HT/HT40, mask MCS rates, etc.)
#CONFIG_HT_OVERRIDES=y

# Support VHT overrides (disable VHT, mask MCS rates, etc.)
#CONFIG_VHT_OVERRIDES=y

# Select control interface backend for external programs, e.g, wpa_cli:
# unix = UNIX domain sockets (default for Linux/*BSD)
# udp = UDP sockets using localhost (127.0.0.1)
# named_pipe = Windows Named Pipe (default for Windows)
# udp-remote = UDP sockets with remote access (only for tests systems/purpose)
# y = use default (backwards compatibility)
# If this option is commented out, control interface is not included in the
# build.
CONFIG_CTRL_IFACE=y

# This can be used to reduce the size of the wpa_supplicant considerably
# if debugging code is not needed. The size reduction can be around 35%
# (e.g., 90 kB).
CONFIG_NO_STDOUT_DEBUG=y

# Remove IEEE 802.11i/WPA-Personal ASCII passphrase support
# This option can be used to reduce code size by removing support for
# converting ASCII passphrases into PSK. If this functionality is removed, the
# PSK can only be configured as the 64-octet hexstring (e.g., from
# wpa_passphrase). This saves about 0.5 kB in code size.
#CONFIG_NO_WPA_PASSPHRASE=y

# Disable scan result processing (ap_mode=1) to save code size by about 1 kB.
# This can be used if ap_scan=1 mode is never enabled.
#CONFIG_NO_SCAN_PROCESSING=y

# Select configuration backend:
# file = text file (e.g., wpa_supplicant.conf; note: the configuration file
#	path is given on command line, not here; this option is just used to
#	select the backend that allows configuration files to be used)
# winreg = Windows registry (see win_example.reg for an example)
CONFIG_BACKEND=file

# Remove configuration write functionality (i.e., to allow the configuration
# file to be updated based on runtime configuration changes). The runtime
# configuration can still be changed, the changes are just not going to be
# persistent over restarts. This option can be used to reduce code size by
# about 3.5 kB.
#CONFIG_NO_CONFIG_WRITE=y

# Remove support for configuration blobs to reduce code size by about 1.5 kB.
#CONFIG_NO_CONFIG_BLOBS=y

# PeerKey handshake for Station to Station Link (IEEE 802.11e DLS)
#CONFIG_PEERKEY=y

# IEEE 802.11w (management frame protection), also known as PMF
# Driver support is also needed for IEEE 802.11w.
#CONFIG_IEEE80211W=y

# If CONFIG_TLS=internal is used, additional library and include paths are
# needed for LibTomMath. Alternatively, an integrated, minimal version of
# LibTomMath can be used. See beginning of libtommath.c for details on benefits
# and drawbacks of this option.
CONFIG_INTERNAL_LIBTOMMATH=y
#ifndef CONFIG_INTERNAL_LIBTOMMATH
#LTM_PATH=/usr/src/libtommath-0.39
#CFLAGS += -I$(LTM_PATH)
#LIBS += -L$(LTM_PATH)
#LIBS_p += -L$(LTM_PATH)
#endif
# At the cost of about 4 kB of additional binary size, the internal LibTomMath
# can be configured to include faster routines for exptmod, sqr, and div to
# speed up DH and RSA calculation considerably
#CONFIG_INTERNAL_LIBTOMMATH_FAST=y

# IEEE Std 802.11r-2008 (Fast BSS Transition)
#CONFIG_IEEE80211R=y

# Add support for writing debug log to a file (/tmp/wpa_supplicant-log-#.txt)
#CONFIG_DEBUG_FILE=y

# Send debug messages to syslog instead of stdout
#CONFIG_DEBUG_SYSLOG=y
# Set syslog facility for debug messages
#CONFIG_DEBUG_SYSLOG_FACILITY=LOG_DAEMON

# Add support for sending all debug messages (regardless of debug verbosity)
# to the Linux kernel tracing facility. This helps debug the entire stack by
# making it easy to record everything happening from the driver up into the
# same file, e.g., using trace-cmd.
#CONFIG_DEBUG_LINUX_TRACING=y

# Enable privilege separation (see README 'Privilege separation' for details)
#CONFIG_PRIVSEP=y

# Enable mitigation against certain attacks against TKIP by delaying Michael
# MIC error reports by a random amount of time between 0 and 60 seconds
#CONFIG_DELAYED_MIC_ERROR_REPORT=y

# Enable tracing code for developer debugging
# This tracks use of memory allocations and other registrations and reports
# incorrect use with a backtrace of call (or allocation) location.
#CONFIG_WPA_TRACE=y
# For BSD, uncomment these.
#LIBS += -lexecinfo
#LIBS_p += -lexecinfo
#LIBS_c += -lexecinfo

# Use libbfd to get more details for developer debugging
# This enables use of libbfd to get more detailed symbols for the backtraces
# generated by CONFIG_WPA_TRACE=y.
#CONFIG_WPA_TRACE_BFD=y
# For BSD, uncomment these.
#LIBS += -lbfd -liberty -lz
#LIBS_p += -lbfd -liberty -lz
#LIBS_c += -lbfd -liberty -lz

CONFIG_TLS = %ssl%

# TLS-based EAP methods require at least TLS v1.0. Newer version of TLS (v1.2)
# can be enabled to enable use of stronger crypto algorithms. It should be
# noted that some existing TLS v1.0 -based implementation may not be compatible
# with TLS v1.2 message (ClientHello is sent prior to negotiating which version
# will be used)
CONFIG_TLSV12=y

# wpa_supplicant depends on strong random number generation being available
# from the operating system. os_get_random() function is used to fetch random
# data when needed, e.g., for key generation. On Linux and BSD systems, this
# works by reading /dev/urandom. It should be noted that the OS entropy pool
# needs to be properly initialized before wpa_supplicant is started. This is
# important especially on embedded devices that do not have a hardware random
# number generator and may by default start up with minimal entropy available
# for random number generation.
#
# As a safety net, wpa_supplicant is by default trying to internally collect
# additional entropy for generating random data to mix in with the data fetched
# from the OS. This by itself is not considered to be very strong, but it may
# help in cases where the system pool is not initialized properly. However, it
# is very strongly recommended that the system pool is initialized with enough
# entropy either by using hardware assisted random number generator or by
# storing state over device reboots.
#
# wpa_supplicant can be configured to maintain its own entropy store over
# restarts to enhance random number generation. This is not perfect, but it is
# much more secure than using the same sequence of random numbers after every
# reboot. This can be enabled with -e<entropy file> command line option. The
# specified file needs to be readable and writable by wpa_supplicant.
#
# If the os_get_random() is known to provide strong random data (e.g., on
# Linux/BSD, the board in question is known to have reliable source of random
# data from /dev/urandom), the internal wpa_supplicant random pool can be
# disabled. This will save some in binary size and CPU use. However, this
# should only be considered for builds that are known to be used on devices
# that meet the requirements described above.
# CONFIG_NO_RANDOM_POOL=y

# IEEE 802.11n (High Throughput) support (mainly for AP mode)
CONFIG_IEEE80211N=y

# IEEE 802.11ac (Very High Throughput) support (mainly for AP mode)
# (depends on CONFIG_IEEE80211N)
#CONFIG_IEEE80211AC=y

# Wireless Network Management (IEEE Std 802.11v-2011)
# Note: This is experimental and not complete implementation.
#CONFIG_WNM=y

# Interworking (IEEE 802.11u)
# This can be used to enable functionality to improve interworking with
# external networks (GAS/ANQP to learn more about the networks and network
# selection based on available credentials).
#CONFIG_INTERWORKING=y

# Hotspot 2.0
#CONFIG_HS20=y

# Disable roaming in wpa_supplicant
#CONFIG_NO_ROAMING=y

# AP mode operations with wpa_supplicant
# This can be used for controlling AP mode operations with wpa_supplicant. It
# should be noted that this is mainly aimed at simple cases like
# WPA2-Personal while more complex configurations like WPA2-Enterprise with an
# external RADIUS server can be supported with hostapd.
CONFIG_AP=y

CONFIG_BGSCAN_LEARN=y

# P2P (Wi-Fi Direct)
# This can be used to enable P2P support in wpa_supplicant. See README-P2P for
# more information on P2P operations.
#CONFIG_P2P=y

# Enable TDLS support
#CONFIG_TDLS=y

# Wi-Fi Direct
# This can be used to enable Wi-Fi Direct extensions for P2P using an external
# program to control the additional information exchanges in the messages.
#CONFIG_WIFI_DISPLAY=y

# Autoscan
# This can be used to enable automatic scan support in wpa_supplicant.
# See wpa_supplicant.conf for more information on autoscan usage.
#
# Enabling directly a module will enable autoscan support.
# For exponential module:
#CONFIG_AUTOSCAN_EXPONENTIAL=y
# For periodic module:
#CONFIG_AUTOSCAN_PERIODIC=y
# For the mixed exponential and periodic module
CONFIG_AUTOSCAN_MIXED=y

# The size limit on the temporary config file created while saving the supplicant's
# configuration to storage.
CONFIG_TEMP_CONFIG_FILE_SIZE = 8192

# Password (and passphrase, etc.) backend for external storage
# These optional mechanisms can be used to add support for storing passwords
# and other secrets in external (to wpa_supplicant) location. This allows, for
# example, operating system specific key storage to be used
#
# External password backend for testing purposes (developer use)
#CONFIG_EXT_PASSWORD_TEST=y
```

## Linux-kernel/linux/arch/arm/mach-mt3620/Kconfig
```kconfig
menuconfig ARCH_MT3620
   bool "MT3620 family" if ARCH_MULTI_V7
   select ARCH_WANT_OPTIONAL_GPIOLIB
   select ARM_AMBA
   select ARM_GIC
   select POWER_RESET
   select POWER_RESET_MT362X
   select CONFIG_ARCH_MTD_XIP
   select ARCH_MEDIATEK
   help
     This option enables support for systems using MT3620.

     You must boot using a Flattened Device Tree in order to use these
     platforms. The traditional (ATAGs) boot method is not usable on
     these boards with this option.

if ARCH_MT3620


endif
```

## Linux-kernel/linux/drivers/mt3620hif/Kconfig
```kconfig
menuconfig MT3620HIF
	tristate "MT3620 HIF support"
	---help---
	  Wireless driver for the MT3620 SoC
```

## Linux-kernel/linux/drivers/net/wireless/mt3620/Kconfig
```kconfig
menuconfig MT3620_WIFI
	tristate "MT3620 Wireless LAN support"
    depends on CFG80211
	---help---
	  Wireless driver for the MT3620 SoC

menuconfig MT3620_WIFI_DEBUG
	bool "MT3620 Wi-Fi debug logging"
	depends on MT3620_WIFI
	help
	  Debug logging for MT3620 Wi-Fi driver

menuconfig MT3620_WIFI_PACKET_DEBUG
	bool "MT3620 Wi-Fi packet debug logging"
	depends on MT3620_WIFI_DEBUG
	help
		Debug logging for packets comming into MT3620 Wi-Fi driver
```
